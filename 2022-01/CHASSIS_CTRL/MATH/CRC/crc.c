#include "crc.h"

//USART8
_POWER power;
float Super_C_Power;
int16_t Receive_Uart8_Buff[10];
int8_t Send8_counter,flag_uart8_conversion_rw;


/* Modbus-RTU读取报文 */
uint8_t r_DPM8600[8] = {0x01,           //地址码
                        0x03,           //功能码，读寄存器数据
                        0x10, 0x01,     //数据地址
                        0x00, 0x02,     //读取数据个数
                        0x00, 0x00};    //CRC码

/* Modbus-RTU写入报文 */
uint8_t w_DPM8600[13] = {0x01,          //地址码
                         0x10,          //功能码，写多个寄存器数据
                         0x00, 0x00,    //寄存器起止地址
                         0x00, 0x02,    //寄存器数目
                         0x04,          //写入的字节数
                         0x00, 0x00,    //设定的电压值 [7-8]
                         0x00, 0x00,    //设定的电流值 [9-10]
                         0x00, 0x00};   //CRC码

/* CRC 高位字节值表 */
static uint8_t auchCRCHi[] =
{
	0x00, 0xC1, 0x81, 0x40, 0x01, 0xC0, 0x80, 0x41, 0x01, 0xC0, 0x80, 0x41, 0x00, 0xC1, 0x81,
	0x40, 0x01, 0xC0, 0x80, 0x41, 0x00, 0xC1, 0x81, 0x40, 0x00, 0xC1, 0x81, 0x40, 0x01, 0xC0,
	0x80, 0x41, 0x01, 0xC0, 0x80, 0x41, 0x00, 0xC1, 0x81, 0x40, 0x00, 0xC1, 0x81, 0x40, 0x01,
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	0x00, 0xC1, 0x81, 0x40, 0x01, 0xC0, 0x80, 0x41, 0x01, 0xC0, 0x80, 0x41, 0x00, 0xC1, 0x81,
	0x40
};
/* CRC 低位字节值表 */
static uint8_t auchCRCLo[] =
{
	0x00, 0xC0, 0xC1, 0x01, 0xC3, 0x03, 0x02, 0xC2, 0xC6, 0x06, 0x07, 0xC7, 0x05, 0xC5, 0xC4,
	0x04, 0xCC, 0x0C, 0x0D, 0xCD, 0x0F, 0xCF, 0xCE, 0x0E, 0x0A, 0xCA, 0xCB, 0x0B, 0xC9, 0x09,
	0x08, 0xC8, 0xD8, 0x18, 0x19, 0xD9, 0x1B, 0xDB, 0xDA, 0x1A, 0x1E, 0xDE, 0xDF, 0x1F, 0xDD,
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	0x44, 0x84, 0x85, 0x45, 0x87, 0x47, 0x46, 0x86, 0x82, 0x42, 0x43, 0x83, 0x41, 0x81, 0x80,
	0x40
};

/**
  * @name   N_CRC16
  * @brief  CRC-16校验码运算
  * @param  *updata:需发送的通讯信息数组    len:通讯信息的帧数
  * @retval none
  * @attention none
*/
uint16_t N_CRC16(uint8_t *updata, int len)
{
    uint8_t uchCRCHi = 0xff;//高8位CRC字节初始化
    uint8_t uchCRCLo = 0xff;//低8位CRC字节初始化
    uint16_t uindex;//CRC循环中的索引

    while (len--)//等待通讯数组的CRC-16校验码计算完毕
    {
        uindex = uchCRCHi ^ *updata++;//索引为通讯信息帧的第n(n为从0至len)个字节与CRC寄存器的高8位进行异或运算
        uchCRCHi = uchCRCLo ^ auchCRCHi[uindex];//高八位为低八位与高位字节索引值异或运算
        uchCRCLo = auchCRCLo[uindex];//低八位为高八位字节索引值
    }
    return (uchCRCHi << 8 | uchCRCLo);//合并高低8位，反馈完整的16位CRC校验码
}

/**
  * @name   ProduceCRC
  * @brief  生成对应CRC-16校验码
  * @param  *srcArray:需发送的modbus代码数组  b:srcArray数组的大小
  * @retval none
  * @attention none
*/
void ProduceCRC(uint8_t *srcArray, int b)
{
    int a = (b - 2);    
    unsigned short kk = N_CRC16(srcArray, a);//去除最后两位进行CRC-16校验码运算

    srcArray[a] = kk / 256;
    srcArray[a + 1] = kk % 256;//最后两位赋值为算得的CRC-16校验码
}
/**
  * @name   UART8_SendByte_r
  * @brief  主机发送读取电流电压值函数
  * @param  none
  * @retval none
  * @attention none
*/
void UART8_SendByte_r(void)
{
	ProduceCRC(r_DPM8600, 8);
	USART_SendData(UART8,r_DPM8600[Send8_counter++] );
	if(Send8_counter ==8)
		{   
			USART_ITConfig(UART8, USART_IT_TXE, DISABLE); 
			Send8_counter=0;
		}
}
/**
  * @name   UART8_SendByte_w
  * @brief  主机发送设定电流电压值函数
  * @param  set_U:设定的电压值  set_I:设定的电流值
  * @retval none
  * @attention none
*/
void UART8_SendByte_w(float set_U, float set_I)
{
	uint16_t U, I;

    U = (uint16_t)(set_U * 100);
    I = (uint16_t)(set_I * 1000);
    w_DPM8600[7] = (U >> 8) & 0xFF;
    w_DPM8600[8] = U & 0xFF;
    w_DPM8600[9] = (I >> 8) & 0xFF;
    w_DPM8600[10] = I & 0xFF;
    ProduceCRC(w_DPM8600, 13); //生成CRC检验码
    USART_SendData(UART8,w_DPM8600[Send8_counter++] );
    if(Send8_counter ==13)
    {   
        USART_ITConfig(UART8, USART_IT_TXE, DISABLE); 
        Send8_counter=0;	
    }
}
